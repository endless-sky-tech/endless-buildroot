## general/Config.in
```kconfig
config BR2_OPENIPC_SOC_VENDOR
	string "SoC vendor"
	default "aarch64"

config BR2_OPENIPC_SOC_MODEL
	string "SoC model"
	default "aarch64"

source "$BR2_EXTERNAL_GENERAL_PATH/package/Config.in"
```

## general/package/zlmediakit/Config.in
```kconfig
config BR2_PACKAGE_ZLMEDIAKIT
	bool "zlmediakit"
	depends on BR2_PACKAGE_OPENSSL
	help
	  ZLMediaKit is an high-performance and lightweight stream server and client framework based on C++11.

	  https://github.com/ZLMediaKit/ZLMediaKit
```
